## Documentation/devicetree/bindings/iio/light/capella,cm3323.yaml
```yaml
# SPDX-License-Identifier: (GPL-2.0 OR BSD-2-Clause)
%YAML 1.2
---
$id: http://devicetree.org/schemas/iio/light/capella,cm3323.yaml#
$schema: http://devicetree.org/meta-schemas/core.yaml#

title:
  Capella Microsystems CM3323 Ambient Light Sensor

description: |
  The CM3323 is a color sensor used in mobile devices as an ambient light sensor.

properties:
  compatible:
    const: capella,cm3323

  reg:
    maxItems: 1

  vdd-supply: true

required:
  - compatible
  - reg

additionalProperties: false

examples:
  - |
    light-sensor@10 {
        compatible = "capella,cm3323";
        reg = <0x10>;

        vdd-supply = <&foo_reg>;
    };
...
```
